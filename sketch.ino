#include <Adafruit_GFX.h>
#include <Adafruit_SSD1306.h>

const unsigned char HeroW [] PROGMEM = {
	0x00, 0x7e, 0x5a, 0x7e, 0x7e, 0x46, 0x7e, 0x00
};
const unsigned char HeroB [] PROGMEM = {
	0xff, 0xff, 0xff, 0xff, 0xff, 0xff, 0xff, 0xff
};



// 'layout ', 128x64px
const unsigned char layout  [] PROGMEM = {
	0x00, 0x00, 0x00, 0x00, 0x00, 0x00, 0x00, 0x00, 0x00, 0x00, 0x00, 0x00, 0x00, 0x00, 0x00, 0x00, 
	0x00, 0x00, 0x00, 0x00, 0x00, 0x00, 0x00, 0x00, 0x00, 0x00, 0x00, 0x00, 0x00, 0x00, 0x00, 0x00, 
	0x00, 0x00, 0x00, 0x00, 0x00, 0x00, 0x00, 0x00, 0x00, 0x00, 0x00, 0x00, 0x00, 0x00, 0x00, 0x00, 
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	0x00, 0x00, 0x00, 0x00, 0x00, 0x00, 0x00, 0x00, 0x00, 0x00, 0x00, 0x01, 0x00, 0x00, 0x00, 0x00
};
// 'water 2', 128x16px
const unsigned char water2 [] PROGMEM = {
	0x00, 0x00, 0x00, 0x00, 0x00, 0x00, 0x00, 0x00, 0x00, 0x00, 0x00, 0x00, 0x00, 0x00, 0x00, 0x00, 
	0x00, 0x00, 0x00, 0x00, 0x00, 0x00, 0x00, 0x00, 0x00, 0x00, 0x00, 0x00, 0x00, 0x00, 0x00, 0x00, 
	0x00, 0x00, 0x00, 0x00, 0x00, 0x00, 0x00, 0x00, 0x00, 0x00, 0x00, 0x00, 0x00, 0x00, 0x00, 0x00, 
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	0x00, 0x00, 0x00, 0x00, 0x00, 0x00, 0x00, 0x00, 0x00, 0x00, 0x00, 0x00, 0x00, 0x00, 0x00, 0x00
};
// 'road3', 128x24px
const unsigned char road3 [] PROGMEM = {
	0xff, 0xff, 0xff, 0xff, 0xff, 0xff, 0xff, 0xff, 0xff, 0xff, 0xff, 0xff, 0xff, 0xff, 0xff, 0xff, 
	0xff, 0xff, 0xff, 0xff, 0xff, 0xff, 0xff, 0xff, 0xff, 0xff, 0xff, 0xff, 0xff, 0xff, 0xff, 0xff, 
	0xff, 0xff, 0xff, 0xff, 0xff, 0xff, 0xff, 0xff, 0xff, 0xff, 0xff, 0xff, 0xff, 0xff, 0xff, 0xff, 
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	0xff, 0xff, 0xff, 0xff, 0xff, 0xff, 0xff, 0xff, 0xff, 0xff, 0xff, 0xff, 0xff, 0xff, 0xff, 0xff
};
// 'road2 ', 128x16px
const unsigned char road2  [] PROGMEM = {
	0xff, 0xff, 0xff, 0xff, 0xff, 0xff, 0xff, 0xff, 0xff, 0xff, 0xff, 0xff, 0xff, 0xff, 0xff, 0xff, 
	0xff, 0xff, 0xff, 0xff, 0xff, 0xff, 0xff, 0xff, 0xff, 0xff, 0xff, 0xff, 0xff, 0xff, 0xff, 0xff, 
	0xff, 0xff, 0xff, 0xff, 0xff, 0xff, 0xff, 0xff, 0xff, 0xff, 0xff, 0xff, 0xff, 0xff, 0xff, 0xff, 
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	0xff, 0xff, 0xff, 0xff, 0xff, 0xff, 0xff, 0xff, 0xff, 0xff, 0xff, 0xff, 0xff, 0xff, 0xff, 0xff
};

const unsigned char water3 [] PROGMEM = {
	0x00, 0x00, 0x00, 0x00, 0x00, 0x00, 0x00, 0x00, 0x00, 0x00, 0x00, 0x00, 0x00, 0x00, 0x00, 0x00, 
	0x00, 0x00, 0x00, 0x00, 0x00, 0x00, 0x00, 0x00, 0x00, 0x00, 0x00, 0x00, 0x00, 0x00, 0x00, 0x00, 
	0x00, 0x00, 0x00, 0x00, 0x00, 0x00, 0x00, 0x00, 0x00, 0x00, 0x00, 0x00, 0x00, 0x00, 0x00, 0x00, 
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	0x00, 0x00, 0x00, 0x00, 0x00, 0x00, 0x00, 0x00, 0x00, 0x00, 0x00, 0x00, 0x00, 0x00, 0x00, 0x00
};



#define SCREEN_WIDTH 128
#define SCREEN_HEIGHT 64

const int X_pin = 0; // analog pin connected to X output
const int Y_pin = 1; // analog pin connected to Y output

Adafruit_SSD1306 display(SCREEN_WIDTH, SCREEN_HEIGHT, &Wire, -1);
int ypos;
int xpos;
int oldy;
int oldx;
int vel =8;


int carSize = 32;
int logSize = 64;
boolean start = true;

int stage = 0;





void setup() {
  Serial.begin(115200);
  if(!display.begin(SSD1306_SWITCHCAPVCC, 0x3C)) {
    Serial.println(F("SSD1306 allocation failed"));
    for(;;);
  }
  delay(2000);
  display.clearDisplay();
  display.display();

}

int carxL[3] = {-24, 120,-24};
int carxR[3]= {-1000,-1000,-1000};
int caryU[3] = {-1000, -1000,-1000};
int caryD[3] = {-1000, -1000,-1000};

int logxL[3] = {-24, 120,-24};
int logxR[3]= {-1000,-1000,-1000};
int logyU[3] = {-1000, -1000,-1000};
int logyD[3] = {-1000, -1000,-1000};

int logVels[3] = {0,0,0};

		
void moveCar2(){
	display.fillRect(carxL[0], caryU[0], carSize, 6, WHITE);
	carxL[0]+=8;
	if(carxL[0] >= 128 +carSize){
		carxL[0] = -24;
	}
	carxR[0] = carxL[0] + carSize;

	display.fillRect(carxL[1], caryU[1], carSize, 6, WHITE);
	carxL[1]-=10;
	if(carxL[1] <= 0 - carSize){
		carxL[1] = 120;
	}
	carxR[1] = carxL[1] + carSize;



}

void moveCar3(){


	display.fillRect(carxL[0], caryU[0], carSize, 6, WHITE);
	carxL[0]+=8;
	if(carxL[0] >= 128 +carSize){
		carxL[0] = -24;
	}
	carxR[0] = carxL[0] + carSize;

	display.fillRect(carxL[1], caryU[1], carSize, 6, WHITE);
	carxL[1]-=10;
	if(carxL[1] <= 0 - carSize){
		carxL[1] = 120;
	}
	carxR[1] = carxL[1] + carSize;

	display.fillRect(carxL[2], caryU[2], carSize, 6, WHITE);
	carxL[2]+=6;
	if(carxL[2] >= 128 +carSize){
		carxL[2] = -24;
	}
	carxR[2] = carxL[2] + carSize;
}

void moveLog2(){

	logVels[0] = (int)random(3,9);

	display.fillRect(logxL[0], logyU[0], logSize, 8, BLACK);
	logxL[0]+=logVels[0];
	if(logxL[0] >= 128 +logSize){
		logxL[0] = -24;
	}
	logxR[0] = logxL[0] + logSize;

	logVels[1] = -(int)random(3,9);

	display.fillRect(logxL[1], logyU[1], logSize, 8, BLACK);
	logxL[1]+=logVels[1];
	if(logxL[1] <= 0 - logSize){
		logxL[1] = 120;
	}
	logxR[1] = logxL[1] + logSize;




}

void moveLog3(){

	logVels[0] = (int)random(3,9);

	display.fillRect(logxL[0], logyU[0], logSize, 8, BLACK);
	logxL[0]+=logVels[0];
	if(logxL[0] >= 128 +logSize){
		logxL[0] = -24;
	}
	logxR[0] = logxL[0] + logSize;

	logVels[1] = -(int)random(3,9);

	display.fillRect(logxL[1], logyU[1], logSize, 8, BLACK);
	logxL[1]+=logVels[1];
	if(logxL[1] <= 0 - logSize){
		logxL[1] = 120;
	}
	logxR[1] = logxL[1] + logSize;

	logVels[2] = (int)random(3,9);

	display.fillRect(logxL[2], logyU[2], logSize, 8, BLACK);
	logxL[2]+=logVels[2];
	if(logxL[2] >= 128 +logSize){
		logxL[2] = -24;
	}
	logxR[2] = logxL[2] + logSize;
}


boolean over = false;
int mapp = 1;


void movement(const unsigned char twoWide [] PROGMEM, const unsigned char threeWide [] PROGMEM){
  display.clearDisplay();
  oldy = ypos;
  oldx = xpos;
	display.drawBitmap(0,0,layout,128,64,WHITE);
  display.drawBitmap(0,8,twoWide,128,16,BLACK);
	display.drawBitmap(0,32,threeWide,128,24,BLACK);

	display.setCursor(45,0);
	display.setTextColor(WHITE);
	display.print("Stage ");
	display.print(stage);


  ypos -= ((analogRead(Y_pin))-512)/63;
  xpos -= ((analogRead(X_pin))-512)/63;

	if(mapp == 2 && ypos == 48){
	
			if(!(xpos >= logxL[2] && xpos + 8 <= logxR[2])){
				over = true;
			}
			xpos +=logVels[2];
		}else if(mapp == 2 && ypos == 40){

			if(!(xpos >= logxL[1] && xpos + 8 <= logxR[1])){
				over = true;
			}
			xpos +=logVels[1];
		}else if(mapp == 2 && ypos == 32){
		
			if(!(xpos >= logxL[0] && xpos + 8 <= logxR[0])){
				over = true;
			}
			xpos +=logVels[0];
		}

	if(mapp == 1 && ypos == 16){
		
			if(!(xpos >= logxL[1] && xpos + 8 <= logxR[1])){
				over = true;
			}
			xpos +=logVels[1];
		}else if(mapp == 1 && ypos == 8){

			if(!(xpos >= logxL[0] && xpos + 8 <= logxR[0])){
				over = true;
			}
			xpos +=logVels[0];
		}



	for(int i = 0; i < 3; i++){
		if(xpos >= carxL[i] && xpos + 8 <= carxR[i] && ypos +4 > caryU[i] && ypos +4 < caryD[i]){

			over = true;
		}
	}
	if(mapp == 1){
		moveLog2();
		moveCar3();

	}else{
	
		moveLog3();
		moveCar2();

	}


	display.drawBitmap(xpos,ypos,HeroB,8,8,BLACK);
	display.drawBitmap(xpos,ypos,HeroW,8,8,WHITE);
	display.display();

  if(xpos <0){ // MODIFY THIS WHEN ON LOG
    xpos = 120;
  }
  else if(xpos >120){
    xpos = 0;
  }
  if(ypos != oldy || xpos != oldx){ // the easy solutin is to get rid of this
    delay(75);
  }
	delay(25);
}


boolean waterFirst = false;
boolean roadFirst = false;
int generator = 10; 
void new_screen(){
  if(ypos < 8){
    ypos = 56;
		generator = random(0,10);

		stage++;
  }
}


void loop() {
	if(over == false){
		new_screen();
	if(generator < 5){
			mapp =1;
			caryU[0] = 31;
			caryU[1] = 41;
			caryU[2] = 50;

			caryD[0] = 37;
			caryD[1] = 47;
			caryD[2] = 56;

			logyU[0] = 8;
			logyU[1] = 16;
	

			logyD[0] = 16;
			logyD[1] = 24;




			movement(water2, road3);

	}else{
			mapp =2;
			caryU[0] = 8;
			caryU[1] = 18;
	

			caryD[0] = 14;
			caryD[1] = 24;

			logyU[0] = 32;
			logyU[1] = 40;
			logyU[2] = 48;

			logyD[0] = 40;
			logyD[1] = 48;
			logyD[2] = 56;



			movement(road2, water3);

	}
	}
	if(over == true){
		stage = 0;
		start = true;
		display.clearDisplay();
		display.display();
		delay(500);
		setup();
		over = false;

		ypos = 0;
		xpos = 0;
		}
}